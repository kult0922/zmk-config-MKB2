// カスタムビヘービア定義ファイル
// MKB.dtsi から include されるため、L/R 全ビルドで有効になる。
// MKB.keymap に書くと keymap-editor の保存で上書き消去されるため、ここで管理する。

// msc の引数は SCRL_UP/SCRL_DOWN マクロ経由で渡す必要がある（生の整数は不可）。
// ZMK_POINTING_DEFAULT_SCRL_VAL を pointing.h より先に定義することでスクロール量を設定する。
#define ZMK_POINTING_DEFAULT_SCRL_VAL 80

#include <dt-bindings/zmk/pointing.h>

/ {
    // ロータリーエンコーダー用スクロールビヘービア
    // C_AC_SCROLL_UP/DOWN (Consumer Control) は macOS で認識されないため
    // HID マウスホイールイベント (msc) を直接送信する。
    enc_scroll: enc_scroll {
        compatible = "zmk,behavior-sensor-rotate";
        #sensor-binding-cells = <0>;
        bindings = <&msc SCRL_UP>, <&msc SCRL_DOWN>;
    };
};
